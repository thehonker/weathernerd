## local-storage/firmware/esp32c6-supermini/sdkconfig.defaults
```kconfig
# ESP-IDF configuration for WeatherNerd ESP32-C6 SuperMini

# Target
CONFIG_IDF_TARGET="esp32c6"

# Enable LP Core coprocessor
CONFIG_ULP_COPROC_ENABLED=y
CONFIG_ULP_COPROC_TYPE_LP_CORE=y
CONFIG_ULP_COPROC_RESERVE_MEM=8192

# Flash size
CONFIG_ESPTOOLPY_FLASHSIZE_4MB=y

# Partition table
CONFIG_PARTITION_TABLE_CUSTOM=y
CONFIG_PARTITION_TABLE_CUSTOM_FILENAME="partitions.csv"

# FAT filesystem for SD card
CONFIG_FATFS_SUPPORT_SD=y
CONFIG_FATFS_MAX_LFN=127
CONFIG_FATFS_LFN_UNICODE=y
CONFIG_FATFS_VFS_FSTAT_BLKSIZE=4096

# WiFi (enabled for retrieval mode soft-AP)
CONFIG_ESP_WIFI_ENABLED=y
CONFIG_ESP_WIFI_SOFTAP_SUPPORT=y

# HTTP server
CONFIG_HTTPD_MAX_REQ_HDR_LEN=1024

# Disable BLE (not needed)
CONFIG_BT_ENABLED=n
CONFIG_BT_NIMBLE_ENABLED=n
```
